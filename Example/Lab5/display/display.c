#include "display.h"
#include "Math.h"

// знакогенератор CP1251 5x8 пикселей
const uint8_t znakogen[] = { 
    0x00, 0x00, 0x00, 0x00, 0x00, // 0x20	пробел
    0x00, 0x00, 0xF2, 0x00, 0x00, // 0x21	!
    0x00, 0xE0, 0x00, 0xE0, 0x00, // 0x22	"
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    0x10, 0x2A, 0x2C, 0x28, 0x3E, // я
 };

 
//инициализирует дисплей
void init_display()
{
	uint8_t cmd[9],i;//массив с командами инициализации

	cmd[0]=0xe2; //сброс дисплея
	cmd[1]=0x24; //установить термокомпенсацию
	cmd[2]=0xC6;// настройка типа разветки свеху в низ, и слево на право
	cmd[3]=0xA0;// 80 кадров в сек// 1010000# // Установить Frame Rate
	cmd[4]=0xEB;// BIAS 9  //111010##  Установить LCD Bias Ratio
	cmd[5]=0x81;// настройка Vbias
	cmd[6]=0x80;//Vbias=200
	cmd[7]=0x89;// Set RAM Address Control
	cmd[8]=0xAF;//Включить дисплей

	for(i=0;i<9;i++)
	{
		 i2c_write(0x70,cmd[i]);
		 delay_ms(10);
	}
		
}


//tip==0 очистка,
//tip==1 черный,
//tip==2 шахматы.
void ClearLCD(uint8_t tip)
{
	uint16_t a;	
	i2c_write(0x70,0xB0); 	//  Установить адрес страницы 0	0 1	0 1	1 #	# #	# Set PA[3:0]  страница 0
	i2c_write(0x70,0x00); 	// Установить адрес столбца LSB  000000####	Set CA [3:0] колонка 0
	i2c_write(0x70,0x10); 	//Установить адрес столбца MSB   000001####	Set CA [3:0] колонка 0
	
	// выбор типа очистки
	if (tip==0)
	{ 
		for (a=0;a<1056;a++)
		i2c_write(0x72,0x00);
				
	}	
	else
  {
     if(tip==1) 
		 {
		   for (a=0;a<1056;a++)
		    {			
		 	  if (a!=0) {i2c_write(0x72,0xFF);}
		    i2c_write(0x70,0xFF);
	      }				
     }
	   else 
	   {	
  		  for (a=0;a<528;a++)
		    {    
			   i2c_write(0x72,0xAA);
			   i2c_write(0x72,0x55);		
			  }
		 }
  }


}

//отображает пиксель
void ShowPixel(uint8_t x, uint8_t y,uint8_t color)
{
  //номер страницы,разряд пикселя в странице	
	uint8_t PageNo,bit;
	uint8_t data,tmp;//данные страницы
	
 	bit=y%8;//определяю разряд пикселя в странице 
	PageNo=y/8; //определяю с какой страницей работать
	
  set_page(PageNo,x);//устанавливаю страницу и корд.Х
	i2c_read(0x72);//первый раз дисплей вседа возвращает нули 
	tmp=i2c_read(0x72);//читаю содержимое страницы 
	set_page(PageNo,x);//устанавливаю страницу и корд.Х
	
	data=0x01;data<<=bit;//зажигаю нужный пиксель
	//гасить или зажигать пиксель
	if(color==1){data=data|tmp;}
  else {data=(~data)&tmp;};	
	//посылаю дисплею команду	
  i2c_write(0x72,data);	
 
}


//Функция установки страницы памяти(0-8) дисплея и столбцов памяти 0-132
void set_page(uint8_t page,uint8_t column)
{ 
	uint8_t buf[3],i;	
 	
	buf[0]=page|0xB0; //  Установить адрес страницы  1011 #	# #	# Set PA[3:0]  страница 0
  buf[1]=column & 0x0F;// Установить адрес столбца LSB  000000####	Set CA [3:0] колонка 0
  	column=column>>4 ;
  buf[2]=column|0x10;//Установить адрес столбца MSB   000001####	Set CA [7:4] колонка 0  	
	 for(i=0;i<3;i++) {i2c_write(0x70,buf[i]);} 
	
}




//выводит горизонтальную линию начальная координата x0,конечная x1
void Hline(uint8_t x0, uint8_t x1,uint8_t y)
{
	uint8_t i=x0; 
	for (;i<x1;i++){ShowPixel(i,y,1); }
}


//рисует круг
void Circle(uint8_t x, uint8_t y,uint8_t r,uint8_t color)
{
	double fi=0,X,Y,dFi=0.0025;
	uint8_t x1,y1;
	uint16_t i;
	
	 for(i=0;i<400;i++)
	 {
    X=cos(dFi)*r;
		Y=sin(dFi)*r;
		dFi++; 
		x1=(uint8_t)(x+X); 
		y1=(uint8_t)(y+Y);  
		ShowPixel(x1,y1,color); 
 	}
}

//меняет порядок бит в байте на обратный
uint8_t swap(uint8_t byte)
{
  byte = ((byte & 0x55) << 1) | ((byte & 0xAA) >> 1);
  byte = ((byte & 0xCC) >> 2) | ((byte & 0x33) << 2);
  byte = (byte >> 4) | (byte << 4);
	return byte;	
}

//выводит символ 
void Litera(uint8_t x,uint8_t page,uint8_t bukva,uint8_t mode)
{
  uint8_t b;
  uint16_t m;	
	m = (bukva - 0x20);//начало символов
  m*=5;//позиция в знакогенераторе 
  //устанавливаю начальную страницу и корд.Х
	if(mode==1){set_page(page,x);}	
	
  //в знакогенераторе перевернутые буквы
  i2c_write(0x72,swap(znakogen[m])); //отсылаем адрес устройства,данные,запись
  m++;
		
	//рисуем остальные символы буквы
	for (b = 1; b < 5; b++)
  {
	  i2c_write(0x72,swap(znakogen[m]));m++;		
  }

}



//выводит строку
//x,page начало координат
void pstring(uint8_t x,uint8_t page,uint8_t *str,uint8_t cnt)
{
  uint8_t p=0;//позиция в массиве
  Litera(x,page,str[p],1);
	i2c_write(0x72,0); //пробел в 1 пиксель  
	for(p=1;p<cnt;p++)
	{
		  Litera(x,page,str[p],0);
		 i2c_write(0x72,0); //пробел в 1 пиксель 
	}
	
  	
}


